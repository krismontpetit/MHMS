/**************************************************************************************************
  Filename:       MSP430F5438.xcl
  Revised:        $Date: 2010-12-07 13:01:14 -0800 (Tue, 07 Dec 2010) $
  Revision:       $Revision: 24573 $

  Description:    This file is the XLINK command file for the MSP430 IAR C/EC++ Compiler.

  Notes:          This file targets the Texas Instruments MSP430F5438.

  Copyright 2008-2010 Texas Instruments Incorporated. All rights reserved.

  IMPORTANT: Your use of this Software is limited to those specific rights
  granted under the terms of a software license agreement between the user
  who downloaded the software, his/her employer (which must be your employer)
  and Texas Instruments Incorporated (the "License").  You may not use this
  Software unless you agree to abide by the terms of the License. The License
  limits your use, and you acknowledge, that the Software may not be modified,
  copied or distributed unless embedded on a Texas Instruments microcontroller
  or used solely and exclusively in conjunction with a Texas Instruments radio
  frequency transceiver, which is integrated into your product.  Other than for
  the foregoing purpose, you may not use, reproduce, copy, prepare derivative
  works of, modify, distribute, perform, display or sell this Software and/or
  its documentation for any purpose.

  YOU FURTHER ACKNOWLEDGE AND AGREE THAT THE SOFTWARE AND DOCUMENTATION ARE
  PROVIDED “AS IS” WITHOUT WARRANTY OF ANY KIND, EITHER EXPRESS OR IMPLIED,
  INCLUDING WITHOUT LIMITATION, ANY WARRANTY OF MERCHANTABILITY, TITLE,
  NON-INFRINGEMENT AND FITNESS FOR A PARTICULAR PURPOSE. IN NO EVENT SHALL
  TEXAS INSTRUMENTS OR ITS LICENSORS BE LIABLE OR OBLIGATED UNDER CONTRACT,
  NEGLIGENCE, STRICT LIABILITY, CONTRIBUTION, BREACH OF WARRANTY, OR OTHER
  LEGAL EQUITABLE THEORY ANY DIRECT OR INDIRECT DAMAGES OR EXPENSES
  INCLUDING BUT NOT LIMITED TO ANY INCIDENTAL, SPECIAL, INDIRECT, PUNITIVE
  OR CONSEQUENTIAL DAMAGES, LOST PROFITS OR LOST DATA, COST OF PROCUREMENT
  OF SUBSTITUTE GOODS, TECHNOLOGY, SERVICES, OR ANY CLAIMS BY THIRD PARTIES
  (INCLUDING BUT NOT LIMITED TO ANY DEFENSE THEREOF), OR OTHER SIMILAR COSTS.

  Should you have any questions regarding your right to use this Software,
  contact Texas Instruments Incorporated at www.TI.com.
**************************************************************************************************/

//*****************************************************************
//
// The memory areas of the MSP430F5438 microprocessor:
//
//   Peripheral units:                0 - 01FF
//
//   Information memory (FLASH):   1800 - 19FF
//
//   Read-write memory (RAM):      1C00 - 5BFF
//
//   Read-only memory (FLASH):     5C00 - FFFF
//                                 10000-45BFF
//
//*****************************************************************

//*****************************************************************
//
// The following segments are defined in this linker command file:
//
// Data read/write segments (RAM)
// ==============================
//
// segment     Restrictions    Usage
// -------     ------------    --------------------------
// DATA16_I    < 10000         Data16 initialized variables
// DATA16_Z    < 10000         Data16 zero initialized variables
// DATA16_N    < 10000         Data16 uninitialized variables
// DATA16_HEAP < 10000         Data16 heap used by malloc and free
// DATA20_I                    Data20 initialized variables
// DATA20_Z                    Data20 zero initialized variables
// DATA20_N                    Data20 uninitialized variables
// DATA20_HEAP                 Data20 heap used by malloc and free
// CSTACK      < 10000         Runtime stack
//
//
// Program and data read-only segments (FLASH)
// ===========================================
//
// segment     Restrictions    Usage
// -------     ------------    --------------------------
// INFO                        Information memory
// CSTART      < 10000         Program startup code
// CODE                        Program code
// ISR_CODE    < 10000         Program code for interrupt service routines
// DATA16_C    < 10000         Data16 constant data and string literals
// DATA16_ID   < 10000         Data16 initializers for DATA16_I
// DATA20_C                    Data20 constant data and string literals
// DATA20_ID                   Data20 initializers for DATA20_I

// Program     5C00-C9FF       All code restricted to < 0x10000 plus whatever other code fits.
// OSAL NV     CA00-F9FF       Reserving 24 pages for use by OSAL NV. See ZIGNV_BEG below.
// Program     FA00-FF7F       All code restricted to < 0x10000 plus whatever other code fits.

// INTVEC      FF80-FFFF       Interrupt vectors
// RESET       FFFE-FFFF       The reset vector
//
//*****************************************************************

-D_LO_ROM_BEG=0x05C00
-D_LO_ROM_END=0x0FF7F
-D_HI_ROM_BEG=0x10000
-D_HI_ROM_END=0x45BFF

// NV memory segment size must coincide with page declarations in "hal_board_cfg.h" file.
-D_ZIGNV_BEG=0x0CA00
-D_ZIGNV_END=0x0F9FF

// ---------------------------------------------------------
// Define cpu.

-cmsp430

// ---------------------------------------------------------
// Read-write memory.

-Z(DATA)DATA16_I,DATA16_Z,DATA16_N,DATA16_HEAP+_DATA16_HEAP_SIZE=1C00-5BFF
-Z(DATA)CSTACK+_STACK_SIZE#

// ---------------------------------------------------------
// Information memory

-Z(CODE)INFO=1800-19FF
-Z(CODE)INFOA=1980-19FF
-Z(CODE)INFOB=1900-197F
-Z(CODE)INFOC=1880-18FF
-Z(CODE)INFOD=1800-187F

// ---------------------------------------------------------
// Low memory only Code

-Z(CODE)CSTART,ISR_CODE=_LO_ROM_BEG-_LO_ROM_END

// ---------------------------------------------------------
// Internal flash used for NV address space.

-Z(CODE)ZIGNV_ADDRESS_SPACE=_ZIGNV_BEG-_ZIGNV_END

// ---------------------------------------------------------
// Interrupt vectors

-Z(CODE)INTVEC=FF80-FFFF
-Z(CODE)RESET=FFFE-FFFF

// ---------------------------------------------------------
// Constant data

-Z(CONST)DATA16_C,DATA16_ID,DIFUNCT=_LO_ROM_BEG-_LO_ROM_END
-Z(CONST)DATA20_C,DATA20_ID=_LO_ROM_BEG-_LO_ROM_END

// ---------------------------------------------------------
// Code

-Z(CODE)CODE=_LO_ROM_BEG-_LO_ROM_END,_HI_ROM_BEG-_HI_ROM_END

